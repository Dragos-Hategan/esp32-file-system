## components/touch_xpt2046/Kconfig
```kconfig
menu "Touch Controller XPT2046 Configuration"
    
    config TOUCH_SPI_HOST
        int "Touch SPI host (spi_host_device_t)"
        range 1 2
        default 1
        help
            SPI host for touch controller.
            Typically same as LCD SPI host.

    config TOUCH_SPI_HZ
        int "Touch SPI clock (Hz)"
        range 100000 26000000
        default 2000000
        help
            SPI clock for the touch controller.     
        
    config TOUCH_SPI_MISO_GPIO
        int "Touch SPI MISO GPIO"
        range -1 47
        default -1

    config TOUCH_SPI_MOSI_GPIO
        int "Touch SPI MOSI GPIO"
        range -1 47
        default -1

    config TOUCH_SPI_SCLK_GPIO
        int "Touch SPI SCLK GPIO"
        range -1 47
        default -1        

    config TOUCH_CS_GPIO
        int "Touch CS GPIO"
        range -1 47
        default -1
        help
            GPIO number for the touch controller chip select pin.

    config TOUCH_IRQ_GPIO
        int "Touch IRQ GPIO"
        range -1 47
        default -1
        help
            GPIO number for touch IRQ (active LOW on XPT2046).
            Use -1 to disable IRQ pin.

    config TOUCH_RST_GPIO
        int "Touch reset GPIO (-1 to disable)"
        range -1 47
        default -1        

    config TOUCH_SWAP_XY
        bool "Swap X and Y coordinates"
        default 0

    config TOUCH_MIRROR_X
        bool "Mirror X axis"
        default 0

    config TOUCH_MIRROR_Y
        bool "Mirror Y axis"
        default 0

endmenu
```

## sdkconfig.defaults
```kconfig
# === Build / Toolchain ===
# [FPS CRITICAL]
CONFIG_COMPILER_OPTIMIZATION_PERF=y              

# === Flash & Partitions ===
CONFIG_ESPTOOLPY_FLASHMODE_QIO=y
CONFIG_ESPTOOLPY_FLASHSIZE_4MB=y                 
CONFIG_ESPTOOLPY_FLASHSIZE="4MB"
CONFIG_PARTITION_TABLE_CUSTOM=y                   
CONFIG_PARTITION_TABLE_CUSTOM_FILENAME="partitions_modified.csv"
CONFIG_PARTITION_TABLE_FILENAME="partitions_modified.csv"         

# === LVGL – core / OS / libc ===
CONFIG_LV_USE_CLIB_MALLOC=y                       
CONFIG_LV_USE_CLIB_STRING=y
CONFIG_LV_USE_CLIB_SPRINTF=y
CONFIG_LV_OS_FREERTOS=y                           
CONFIG_LV_USE_FREERTOS_TASK_NOTIFY=y       
CONFIG_LV_DRAW_THREAD_STACK_SIZE=24576       

# === LVGL – performance / rendering ===
# 20 ms tick target (~50 Hz) [FPS CRITICAL]
CONFIG_LV_DEF_REFR_PERIOD=20      
# Two draw units (parallelism) [FPS CRITICAL]                
CONFIG_LV_DRAW_SW_DRAW_UNIT_CNT=2     
# Hot code in IRAM (faster draw) [FPS CRITICAL]            
CONFIG_LV_ATTRIBUTE_FAST_MEM_USE_IRAM=y           

# === LVGL - filesystem & image decoders ===
# Use stdio VFS driver on top of /sdcard to avoid touching managed components
CONFIG_LV_USE_FS_STDIO=y
CONFIG_LV_FS_STDIO_LETTER=83
CONFIG_LV_FS_STDIO_PATH="/sdcard"
CONFIG_LV_FS_STDIO_CACHE_SIZE=1024
CONFIG_LV_USE_FS_FATFS=n
CONFIG_LV_USE_TJPGD=y
CONFIG_LV_USE_BMP=y
CONFIG_LV_USE_LODEPNG=y

# === Display Interface (SPI) ===
CONFIG_BSP_DISPLAY_ENABLED=y                      
CONFIG_BSP_DISPLAY_INTERFACE_SPI=y                
CONFIG_BSP_DISPLAY_CS_GPIO=4
CONFIG_BSP_DISPLAY_MOSI_GPIO=5
CONFIG_BSP_DISPLAY_SCLK_GPIO=6
CONFIG_BSP_DISPLAY_MISO_GPIO=7
CONFIG_BSP_DISPLAY_RST_GPIO=15
CONFIG_BSP_DISPLAY_DC_GPIO=16
CONFIG_BSP_DISPLAY_BACKLIGHT_GPIO=17

# === Display – orientation & color ===
CONFIG_BSP_DISPLAY_ROTATION_SWAP_XY=y             
CONFIG_BSP_DISPLAY_COLOR_SPACE_BGR=y              

# === BSP Display – panel & enablement ===
CONFIG_BSP_DISPLAY_DRIVER_ILI9341=y   
# SPI pixel clock (MHz) [FPS CRITICAL]            
CONFIG_BSP_DISPLAY_PIXEL_CLOCK=40    
# Draw buffer height (lines) [FPS CRITICAL]             
CONFIG_BSP_LCD_DRAW_BUF_HEIGHT=75  
# Double buffering [FPS CRITICAL]               
CONFIG_BSP_LCD_DRAW_BUF_DOUBLE=y                  

# === XPT2046 Touch Controller ===          
CONFIG_TOUCH_SPI_HOST=1
CONFIG_TOUCH_SPI_HZ=2000000
CONFIG_TOUCH_SPI_MISO_GPIO=7
CONFIG_TOUCH_SPI_MOSI_GPIO=5
CONFIG_TOUCH_SPI_SCLK_GPIO=6
CONFIG_TOUCH_CS_GPIO=8
CONFIG_TOUCH_IRQ_GPIO=11
CONFIG_TOUCH_RST_GPIO=-1
CONFIG_TOUCH_SWAP_XY=y
CONFIG_TOUCH_MIRROR_X=y
CONFIG_TOUCH_MIRROR_Y=y

# === SD Card ===   
CONFIG_SDSPI_MOUNT_POINT="/sdcard"
CONFIG_SDSPI_BUS_HOST=2
CONFIG_SDSPI_MAX_FREQ_KHZ=20000
CONFIG_SDSPI_DEVICE_CS_PIN=35
CONFIG_SPSPI_BUS_SCL_PIN=36
CONFIG_SDSPI_BUS_MOSI_PIN=37
CONFIG_SDSPI_BUS_MISO_PIN=38

# === FATFS ===
CONFIG_FATFS_VFS_FSTAT_BLKSIZE=4096
CONFIG_FATFS_LFN_HEAP=y
CONFIG_FATFS_MAX_LFN=255
```
